## conf/machine/qcm6490-idp.conf
```bitbake
#@TYPE: Machine
#@NAME: qcm6490-idp
#@DESCRIPTION: Machine configuration for the IDP Beta Evaluation Kit (EVK), with Qualcomm QCM6490

require conf/machine/include/qcom-qcs6490.inc

MACHINE_FEATURES = "usbhost usbgadget alsa wifi bluetooth"

# This DT currently exist only as patches against linux-qcom-base recipe.
KERNEL_DEVICETREE:pn-linux-qcom-base = " \
                      qcom/qcm6490-idp.dtb \
                      "

KERNEL_DEVICETREE:pn-linux-qcom-custom = " \
                      qcom/rubikpi3.dtb \
                      "

# Additional dtbo to overylay on top of kernel devicetree files
KERNEL_TECH_DTBOS[rubikpi3] = " \
    qcm6490-graphics.dtbo \
    qcm6490-camera-idp.dtbo \
    qcm6490-video.dtbo \
    rubikpi3-overlay.dtbo \
    "

KERNEL_TECH_DTBOS[qcm6490-addons-idp-amoled] = " \
    qcm6490-graphics.dtbo \
    qcm6490-camera-idp.dtbo \
    qcm6490-wlan-idp.dtbo qcm6490-video.dtbo \
    qcm6490-wlan-upstream.dtbo \
    "

# Recipe providers of above dtbo files.
KERNEL_TECH_DTBO_PROVIDERS = "\
    cameradtb \
    qcom-graphicsdevicetree \
    qcom-videodtb \
    wlan-devicetree \
"

IMAGE_INSTALL:append = " htop"
IMAGE_INSTALL:append = " stress-ng"
IMAGE_INSTALL:append = " vim"
IMAGE_INSTALL:append = " screen tmux"
IMAGE_INSTALL:append = " iproute2"
IMAGE_INSTALL:append = " can-utils"
IMAGE_INSTALL:append = " inotify-tools"
IMAGE_INSTALL:append = " python3-ansible"
INHERIT += "rm_work"
```
